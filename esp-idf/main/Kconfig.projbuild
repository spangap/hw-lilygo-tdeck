## esp-idf/main/Kconfig.projbuild
```kconfig
menu "Reticulous board"

choice RETICULOUS_BOARD
    prompt "Target board"
    default RETICULOUS_BOARD_TDECK_PLUS
    help
        Selects pin map / SPI host / TCXO for the LoRa transport.
        All targets are ESP32-S3 with an SX1262 on a board-specific SPI bus.

    config RETICULOUS_BOARD_TDECK_PLUS
        bool "LilyGo T-Deck Plus"

endchoice

endmenu
```
